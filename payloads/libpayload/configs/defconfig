## src/cpu/486/Kconfig
```kconfig
## SPDX-License-Identifier: GPL-2.0-only

config CPU_486
	bool
	select ARCH_486
	select USE_MARCH_486

if CPU_486

choice
	prompt "SMM support"
	default CPU_486_ASEG_SMM

config CPU_486_NO_SMM
	bool "No SMM"
	select NO_SMM

config CPU_486_ASEG_SMM
	bool "SMM in ASEG"
	select SMM_ASEG

config CPU_486_TSEG_SMM
	bool "SMM in TSEG"
	select SMM_TSEG

endchoice


#TODO move into ali northbridge, right above max RAM for CPU, for chipset it is 0 due to aliasing
#shouldn't be at start of the block (could be overridden by DRAM/L2 check)

#TODO NOTICE, for DRAM detection it must be above maximal single bank size or not at single "1" bit boundary

config DCACHE_RAM_BASE
	hex
#	default 0x01000000
#	default 0x04560000
#	default 0x00200000
#	default 0x08000000
	default 0x001a0000

config DCACHE_RAM_SIZE
	hex
	default 0x02000

config DCACHE_BSP_STACK_SIZE
	hex
	default 0x1000

config HEAP_SIZE
	default 0x8000

endif
```

## src/mainboard/abit/Kconfig
```kconfig
if VENDOR_ABIT

choice
	prompt "Mainboard model"

source "src/mainboard/abit/*/Kconfig.name"

endchoice

source "src/mainboard/abit/*/Kconfig"

config MAINBOARD_VENDOR
	default "ABit"

endif # VENDOR_ABIT
```

## src/mainboard/abit/ab-pb4/Kconfig
```kconfig
if BOARD_ABIT_AB_PB4

config BOARD_SPECIFIC_OPTIONS
	def_bool y
	select CPU_486
	select BOARD_ROMSIZE_KB_128
	select MISSING_BOARD_RESET
	select NORTHBRIDGE_ALI_M1489
	select SOUTHBRIDGE_ALI_M1487
	select SUPERIO_WINBOND_W83787IF
	select HAVE_OPTION_TABLE
#	 select HAVE_CMOS_DEFAULT
	select HAVE_PIRQ_TABLE
	select NO_MONOTONIC_TIMER

config MAINBOARD_DIR
	default "abit/ab-pb4"

config MAINBOARD_PART_NUMBER
	default "AB-PB4"

config IRQ_SLOT_COUNT
	int
	default 3
#TODO 4

endif #BOARD_ABIT_AB_PB4
```

## src/mainboard/biostar/mb8433/Kconfig
```kconfig
if BOARD_BIOSTAR_MB8433

config BOARD_SPECIFIC_OPTIONS
	def_bool y
	select CPU_486
	select BOARD_ROMSIZE_KB_128
	select MISSING_BOARD_RESET
	select NORTHBRIDGE_UMC_UM8881
	select SOUTHBRIDGE_UMC_UM8886
	select SUPERIO_UMC_UM8663BF
	select HAVE_OPTION_TABLE
#	select HAVE_CMOS_DEFAULT
	select HAVE_PIRQ_TABLE
	select NO_MONOTONIC_TIMER


#TODO TODO TODO TODO TODO TODO TODO
#https://elixir.bootlin.com/coreboot/4.7/A/ident/pirq_assign_irqs
#required (sets PCI IRQ) if you want to boot from usb, also required if kernel doesn't  reroute
	select PIRQ_ROUTE

config MAINBOARD_DIR
	default "biostar/mb8433"

config MAINBOARD_PART_NUMBER
	default "MB8433"

config IRQ_SLOT_COUNT
	int
	default 3

endif # BOARD_BIOSTAR_MB8433
```

## src/mainboard/zida/4dps/Kconfig
```kconfig
if BOARD_ZIDA_4DPS

config BOARD_SPECIFIC_OPTIONS
	def_bool y
#TODO maybe into cpu/486
	select CPU_486
	select BOARD_ROMSIZE_KB_128
	select MISSING_BOARD_RESET
	select NORTHBRIDGE_SIS_85C496
	select SOUTHBRIDGE_SIS_85C497
	select SUPERIO_WINBOND_W83787IF
#	 select HAVE_OPTION_TABLE
#	 select HAVE_CMOS_DEFAULT
	select HAVE_PIRQ_TABLE
	select NO_MONOTONIC_TIMER

config MAINBOARD_DIR
	default "zida/4dps"

config MAINBOARD_PART_NUMBER
	default "4DPS"

config IRQ_SLOT_COUNT
	int
	default 3

endif #BOARD_ZIDA_4DPS
```

## src/mainboard/zida/4dps/Kconfig.name
```kconfig
config BOARD_ZIDA_4DPS
	bool "Zida 4DPS tomatoboard"
	help
	  experimental, also: Taken PCI400, J-Bond PCI400
```

## src/mainboard/zida/Kconfig
```kconfig
if VENDOR_ZIDA

choice
	prompt "Mainboard model"

source "src/mainboard/zida/*/Kconfig.name"

endchoice

source "src/mainboard/zida/*/Kconfig"

config MAINBOARD_VENDOR
	default "Zida"

endif # VENDOR_ZIDA
```

## src/southbridge/umc/um8886/Kconfig
```kconfig
# SPDX-License-Identifier: GPL-2.0-only

config SOUTHBRIDGE_UMC_UM8886
	bool
	select BOOT_DEVICE_NOT_SPI_FLASH
```
